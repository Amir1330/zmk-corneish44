## boards/shields/corneish44/Kconfig.defconfig
```kconfig
if SHIELD_CORNEISH44_LEFT

config ZMK_KEYBOARD_NAME
    default "corneish44"

config ZMK_SPLIT_ROLE_CENTRAL
    default y

endif

if SHIELD_CORNEISH44_LEFT || SHIELD_CORNEISH44_RIGHT

config ZMK_SPLIT
    default y

endif
```

## boards/shields/corneish44/Kconfig.shield
```kconfig
config SHIELD_CORNEISH44_LEFT
    def_bool $(shields_list_contains,corneish44_left)

config SHIELD_CORNEISH44_RIGHT
    def_bool $(shields_list_contains,corneish44_right)
```
